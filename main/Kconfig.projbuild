## main/Kconfig.projbuild
```kconfig
menu "MimiClaw Configuration"

    config MIMI_ENABLE_TELEGRAM
        bool "Enable Telegram Bot"
        default y
        help
            Include Telegram bot polling and message relay.
            Disable for WebSocket-only or CLI-only setups.

    config MIMI_ENABLE_WEBSOCKET
        bool "Enable WebSocket Gateway"
        default y
        help
            Include WebSocket server for real-time browser/app connections.

    config MIMI_ENABLE_WEB_UI
        bool "Enable Web UI"
        default y
        depends on MIMI_ENABLE_WEBSOCKET
        help
            Include the embedded web-based management UI.
            Requires the WebSocket gateway.

    config MIMI_ENABLE_SKILLS
        bool "Enable Skill Engine (Lua runtime)"
        default y
        help
            Include the Lua-based skill engine for user-installable plugins.
            Disable to save ~60 KB RAM.

    config MIMI_ENABLE_CRON
        bool "Enable Cron Service"
        default y
        help
            Include timer-based scheduled task execution.

    config MIMI_ENABLE_HEARTBEAT
        bool "Enable Heartbeat"
        default y
        depends on MIMI_ENABLE_CRON
        help
            Periodic heartbeat that triggers the agent at configurable intervals.

    config MIMI_ENABLE_DISPLAY
        bool "Enable SPI LCD Display (ST7789T)"
        default n
        help
            Enable for boards with an ST7789T SPI LCD.
            Also enables IMU shake-to-toggle and config screen.

    config MIMI_ENABLE_OLED
        bool "Enable SSD1306 OLED"
        default y
        help
            Enable I2C SSD1306 OLED status display.

    config MIMI_ENABLE_OTA
        bool "Enable OTA Updates"
        default y
        help
            Include over-the-air firmware update support.

    config MIMI_ENABLE_HTTP_PROXY
        bool "Enable HTTP Proxy"
        default y
        help
            Include outbound HTTP proxy for external API calls.

    config MIMI_ENABLE_ED25519
        bool "Enable Ed25519 Signature Verification"
        default y
        depends on MIMI_ENABLE_SKILLS
        help
            Include Ed25519-based skill package signature verification.
            Required for secure skill installation from untrusted sources.

    config MIMI_ENABLE_MDNS
        bool "Enable mDNS Discovery"
        default y
        help
            Advertise MimiClaw on the local network via mDNS.
            Accessible at mimiclaw.local after WiFi connects.

endmenu
```

## sdkconfig.defaults
```kconfig
# MimiClaw - Common Default Configuration
# Target-specific settings are in sdkconfig.defaults.esp32s3
CONFIG_FREERTOS_ENABLE_BACKWARD_COMPATIBILITY=y
```

## sdkconfig.defaults.esp32s3
```kconfig
# MimiClaw - ESP32-S3 Target Configuration
CONFIG_IDF_TARGET="esp32s3"

# Flash 16MB + QIO
CONFIG_ESPTOOLPY_FLASHSIZE_16MB=y
CONFIG_ESPTOOLPY_FLASHMODE_QIO=y

# CPU 240MHz
CONFIG_ESP_DEFAULT_CPU_FREQ_MHZ_240=y

# PSRAM 8MB Octal
CONFIG_SPIRAM=y
CONFIG_SPIRAM_MODE_OCT=y
CONFIG_SPIRAM_SPEED_80M=y
CONFIG_SPIRAM_MALLOC_ALWAYSINTERNAL=0
CONFIG_SPIRAM_MALLOC_RESERVE_INTERNAL=131072
CONFIG_SPIRAM_MEMTEST=n

# WiFi memory optimization
CONFIG_ESP_WIFI_STATIC_RX_BUFFER_NUM=3
CONFIG_ESP_WIFI_DYNAMIC_RX_BUFFER_NUM=6
CONFIG_ESP_WIFI_RX_BA_WIN=3
CONFIG_LWIP_TCPIP_RECVMBOX_SIZE=16
CONFIG_LWIP_MAX_SOCKETS=16

# TLS optimization (PSRAM allocation + small buffers + software AES)
CONFIG_MBEDTLS_EXTERNAL_MEM_ALLOC=y
CONFIG_MBEDTLS_DYNAMIC_FREE_CONFIG_DATA=y
CONFIG_MBEDTLS_HARDWARE_AES=n
CONFIG_MBEDTLS_SSL_ALPN=y
CONFIG_MBEDTLS_ASYMMETRIC_CONTENT_LEN=y
CONFIG_MBEDTLS_SSL_IN_CONTENT_LEN=16384
CONFIG_MBEDTLS_SSL_OUT_CONTENT_LEN=16384
CONFIG_MBEDTLS_SSL_PROTO_TLS1_2=y
CONFIG_MBEDTLS_SSL_PROTO_TLS1_3=y

# WebSocket support
CONFIG_HTTPD_WS_SUPPORT=y

# Custom partition table
CONFIG_PARTITION_TABLE_CUSTOM=y
CONFIG_PARTITION_TABLE_CUSTOM_FILENAME="partitions.csv"

# Console/UART for CLI
CONFIG_ESP_CONSOLE_USB_SERIAL_JTAG=y

# Bluetooth — disabled to save ~25KB internal SRAM
CONFIG_BT_ENABLED=n

# Suppress legacy driver warnings
CONFIG_I2S_SUPPRESS_DEPRECATE_WARN=y
```
